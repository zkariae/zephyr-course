## CMakeLists.txt
```
cmake_minimum_required(VERSION 3.20.0)

set(MODULE module1 CACHE STRING "Course module to build (app/<MODULE>/src/main.c)")

# Optional module-specific Kconfig fragment, merged on top of app/prj.conf
if(EXISTS ${CMAKE_CURRENT_SOURCE_DIR}/${MODULE}/prj.conf)
    set(EXTRA_CONF_FILE ${CMAKE_CURRENT_SOURCE_DIR}/${MODULE}/prj.conf)
endif()

find_package(Zephyr REQUIRED HINTS $ENV{ZEPHYR_BASE})
project(${MODULE})

if(NOT EXISTS ${CMAKE_CURRENT_SOURCE_DIR}/${MODULE}/src/main.c)
    message(FATAL_ERROR "Unknown module '${MODULE}': app/${MODULE}/src/main.c not found")
endif()

file(GLOB MODULE_SOURCES ${CMAKE_CURRENT_SOURCE_DIR}/${MODULE}/src/*.c)
target_sources(app PRIVATE ${MODULE_SOURCES})
```

## prj.conf
```kconfig
CONFIG_LOG=y
CONFIG_THREAD_NAME=y
CONFIG_LOG_PRINTK=n
CONFIG_ZBUS=y
CONFIG_TASK_WDT=y
```

## src/main.c
```c
#include <zephyr/kernel.h>
#include <zephyr/logging/log.h>

LOG_MODULE_REGISTER(demo, LOG_LEVEL_DBG);

#define STACK_SIZE 1024

#define PRIO_LOW 7
#define PRIO_MED 5 
#define PRIO_HIGH 3
#define PRIO_COOP -1


void thread_t_low_fn(void *p1, void *p2, void *p3)
{
    while (1) {
        LOG_DBG("T_LOW running");
        k_msleep(300);
    }
}

void thread_t_med_fn(void *p1, void *p2, void *p3)
{
    while (1) {
        LOG_DBG("T_MED running");
        k_msleep(200);
    }
}

void thread_t_high_fn(void *p1, void *p2, void *p3)
{
    while (1) {
        LOG_DBG("T_HIGH running");
        k_msleep(100);
    }
}

void thread_t_coop_fn(void *p1, void *p2, void *p3)
{
    for(int i = 0; i < 5; i++) {
            LOG_DBG("T_COOP running %d", i);
        }
    LOG_DBG("T_COOP finished");    
    k_yield();
}

K_THREAD_DEFINE(thread_t_low, STACK_SIZE, thread_t_low_fn,
                NULL, NULL, NULL, PRIO_LOW, 0, 0);
K_THREAD_DEFINE(thread_t_med, STACK_SIZE, thread_t_med_fn,
                NULL, NULL, NULL, PRIO_MED, 0, 0);
K_THREAD_DEFINE(thread_t_high, STACK_SIZE, thread_t_high_fn,
                NULL, NULL, NULL, PRIO_HIGH, 0, 0);
K_THREAD_DEFINE(thread_t_coop, STACK_SIZE, thread_t_coop_fn,
                NULL, NULL, NULL, PRIO_COOP, 0, 0);

int main(void)
{
    return 0;
}
```
