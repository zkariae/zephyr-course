## prj.conf
```kconfig
# Internal flash is only 64 KB: drop features unused by this module
CONFIG_ZBUS=n
CONFIG_TASK_WDT=n

# Kernel shell: "kernel thread list"
CONFIG_SHELL=y
CONFIG_KERNEL_SHELL=y
CONFIG_SHELL_HISTORY=n
CONFIG_SHELL_WILDCARD=n
CONFIG_SHELL_VT100_COLORS=n
CONFIG_SHELL_CMDS=n
CONFIG_SHELL_STATS=n
CONFIG_THREAD_MONITOR=y
CONFIG_THREAD_STACK_INFO=y
CONFIG_INIT_STACKS=y

# CTF tracing into a RAM buffer, dumped with GDB
CONFIG_TRACING=y
CONFIG_TRACING_CTF=y
CONFIG_TRACING_BACKEND_RAM=y
CONFIG_RAM_TRACING_BUFFER_SIZE=65536
```

## src/main.c
```c
#include <zephyr/kernel.h>
#include <zephyr/logging/log.h>
#include <zephyr/tracing/tracing.h>

LOG_MODULE_REGISTER(homework, LOG_LEVEL_INF);

#define STACK_SIZE            2048
/* Fix: control (10 ms deadline) must preempt maintenance (no short deadline). */
#define CONTROL_PRIORITY         3
#define MAINTENANCE_PRIORITY     4
#define EVENT_PERIOD_MS        250
#define MAINTENANCE_LOAD_US  45000

/* Response-time guarantee: control work starts within 10 ms of the event. */
#define DEADLINE_MS             10
#define WARN_EVERY_N_MISSES     10
#define SUMMARY_EVERY_N_EVENTS  20

struct control_event {
    uint32_t seq;
    uint32_t ready_ms;
};

K_MSGQ_DEFINE(control_queue, sizeof(struct control_event), 4, 4);
K_SEM_DEFINE(maintenance_start, 0, 1);

/* ================================================================== */
/*  Timer expiry: creates one control event                           */
/* ================================================================== */

static void event_timer_expiry(struct k_timer *timer)
{
    ARG_UNUSED(timer);

    static uint32_t seq;
    struct control_event event = {
        .seq = seq++,
        .ready_ms = k_uptime_get_32(),
    };

    /* Timer expiry runs in interrupt context, so never wait here. */
    int ret = k_msgq_put(&control_queue, &event, K_NO_WAIT);

    if (ret != 0) {
        return;
    }

    /* Both threads become ready when the timer interrupt returns. */
    k_sem_give(&maintenance_start);

    sys_trace_named_event("evt_ready", event.seq, 0);
}

K_TIMER_DEFINE(event_timer, event_timer_expiry, NULL);

/* ================================================================== */
/*  Control thread                                                   */
/* ================================================================== */

static void control_fn(void *p1, void *p2, void *p3)
{
    ARG_UNUSED(p1); ARG_UNUSED(p2); ARG_UNUSED(p3);

    uint32_t processed = 0;
    uint32_t misses = 0;
    uint32_t max_latency = 0;

    while (true) {
        struct control_event event;
        int ret = k_msgq_get(&control_queue, &event, K_FOREVER);

        if (ret != 0) {
            LOG_ERR("[CONTROL] receive failed: %d", ret);
            continue;
        }

        uint32_t latency = k_uptime_get_32() - event.ready_ms;

        processed++;
        max_latency = MAX(max_latency, latency);

        if (latency > DEADLINE_MS) {
            misses++;
            /* Rate-limited: first miss, then every Nth miss. */
            if (misses == 1 || (misses % WARN_EVERY_N_MISSES) == 0) {
                LOG_WRN("[CONTROL] deadline miss seq=%u latency=%u ms (misses=%u)",
                        event.seq, latency, misses);
            }
        }

        LOG_INF("[CONTROL] processed seq=%u latency=%u ms", event.seq, latency);

        if ((processed % SUMMARY_EVERY_N_EVENTS) == 0) {
            LOG_INF("[SUMMARY] processed=%u misses=%u max=%u ms (deadline %u ms)",
                    processed, misses, max_latency, DEADLINE_MS);
        }

        sys_trace_named_event("ctrl_done", event.seq, latency);
    }
}

/* ================================================================== */
/*  Background maintenance thread                                    */
/* ================================================================== */

static void maintenance_fn(void *p1, void *p2, void *p3)
{
    ARG_UNUSED(p1); ARG_UNUSED(p2); ARG_UNUSED(p3);

    while (true) {
        k_sem_take(&maintenance_start, K_FOREVER);

        /* This work is important, but it has no short deadline. */
        k_busy_wait(MAINTENANCE_LOAD_US);
    }
}

K_THREAD_DEFINE(control, STACK_SIZE, control_fn,
                NULL, NULL, NULL, CONTROL_PRIORITY, 0, 0);

K_THREAD_DEFINE(maintenance, STACK_SIZE, maintenance_fn,
                NULL, NULL, NULL, MAINTENANCE_PRIORITY, 0, 0);

int main(void)
{
    LOG_INF("=== L6 Homework: Runtime Investigation ===");
    LOG_INF("Control work must start within %d ms", DEADLINE_MS);
    LOG_INF("Inspect, measure, trace, explain, and correct the delay");

    k_timer_start(&event_timer, K_MSEC(500), K_MSEC(EVENT_PERIOD_MS));

    return 0;
}
```
